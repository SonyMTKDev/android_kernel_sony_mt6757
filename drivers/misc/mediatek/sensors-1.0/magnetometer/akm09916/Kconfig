## drivers/misc/mediatek/sensors-1.0/magnetometer/akm09916/Kconfig
```kconfig
config MTK_AKM09916
	tristate "AKM09916 for MediaTek package"
	default n
	help
	  It support different magnetometer sensor.
	  If this option is set, it will support
	  AKMD09911 magnetometer which is a 3-axis electronic
	  compass IC with high sensitive Hall sensor technology.
```

## drivers/misc/mediatek/sensors-1.0/magnetometer/gmc306/Kconfig
```kconfig
config MTK_GMC306
	tristate "GMC306 for MediaTek package"
	default n
	help
	  It support different magnetometer sensor.
	  If this option is set, it will support
	  GMC306 magnetometer which is a 3-axis electronic
	  compass IC with high sensitive Hall sensor technology.
```
